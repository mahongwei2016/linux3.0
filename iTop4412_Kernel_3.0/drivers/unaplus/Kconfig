## iTop4412_Kernel_3.0/drivers/unaplus/Kconfig
```kconfig
menu "UNA-PLUS 3G Modem"
#
# COMBO chip configuration
#
config UNAPLUS
	bool "UNA-PLUS 3G Modem"
	default y
	help
	  UNA-PLUS 3G Modem

endmenu
```
